#include <string.h>
#include <stdlib.h>

#include "sys_autorun.h"
#include "sys_mq.h"
#include "spo2.h"
#include "co2.h"


unsigned int order_spo2=0;
unsigned int count_spo2=0;
unsigned int count_IBP=0;
unsigned int count_co2=0;
unsigned int table_i=0, table_j, co2_i=0;
unsigned char Delay_=0, Delay2=0;
unsigned int count_EKG=0,count_EKG_RESP=0;
int IBP_autorun_delay=0;
int all_data_autorun_count;
int IBP_chang_NIBP;
int sho_autodata_count=100;
unsigned int spo2_table[23][4] = {
{80,71,1,0},
{82,73,2,0},
{84,75,3,0},
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{80,72,0,0},
};

unsigned int spo2_curve[] = {
0x9C, 0x9F, 0xA1, 0xA3, 0xA4, 0xA4, 0xA4, 0xA2, 0xA0, 0x9E,
0x9B, 0x99, 0x97, 0x94, 0x92, 0x8F, 0x8C, 0x88, 0x85, 0x82,
0x7F, 0x7D, 0x7A, 0x77, 0x75, 0x73, 0x71, 0x6F, 0x6E, 0x6C,
0x6B, 0x69, 0x68, 0x66, 0x65, 0x64, 0x62, 0x61, 0x60, 0x60,
0x60, 0x62, 0x68, 0x70, 0x7B, 0x85, 0x8F
};
unsigned int IBP_curve[] = {
0x09,0x0A,0x0B,0x0C,0x0D,0x0F,0x10,0x11,0x12,0x14,
0x16,0x17,0x19,0x1B,0x1D,0x1E,0x1F,0x21,0x22,0x23,
0x25,0x26,0x27,0x27,0x29,0x29,0x2A,0x2B,0x2B,0x2C,
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0x08,0x09
};
unsigned int co2_table[19] = {
380,360,360,360,360,380,380,380,380,370,370,370,370,380,380,380,380,380,380
};

unsigned int resp_table[19] = {
12,10,10,10,10,10,10,8,8,8,8,8,8,10,10,10,10,10,10
};
unsigned int EKG_curve[] =
{
114,114,114,114,114,114,114,115,115,115,115,115,115,116,116,116,
116,116,116,116,117,117,120,124,126,127,127,125,122,119,117,117,
117,117,117,117,118,117,120,137,161,181,184,160,133,112,109,114,
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138,138,138,137,135,133,129,124,121,118,115,114,114,114,115,115};
unsigned int EKG_RESP_curve[] = {
32,32,32,32,32,32,32,32,32,33,33,33,34,34,35,36,36,37,38,39,40,41,
44,45,47,48,50,51,53,55,56,58,60,62,64,66,68,71,73,77,80,82,85,87,
90,92,95,97,100,102,105,108,110,113,116,121,124,126,129,132,134,137,
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49,48,47,46,45,44,43,42,41,41,40,39,39,38,38,37,36,36,35,35,34,34,34
};
unsigned int co2_curve[] = { // 449
//10110000b,00001100b,10000001b,01111100b,
0xA8, 0x0C, 0xA8, 0x0C, 0xA8, 0x0C, 0xA8, 0x0C, 0xA8, 0x0C, 0xA8, 0x0C,
0xA8, 0x0C, 0xA8, 0x0C, 0xA8, 0x0C, 0xA8, 0x0C, 0xA8, 0x0C, 0xA8, 0x0C,
0xA8, 0x0C, 0xA8, 0x0C, 0xA8, 0x0C, 0xA8, 0x0C, 0xA8, 0x0C, 0xA8, 0x0C,
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0xA8, 0x13, 0xA8, 0x12, 0xA8, 0x11, 0xA8, 0x10, 0xA8, 0x10, 0xff
};
void all_data_autorun(void)
 {
   if(Get_DEMO_MOD_ONOFF())
    {
     if(all_data_autorun_count<8) all_data_autorun_count++;
     else all_data_autorun_count=0;
     if(all_data_autorun_count%1==0)
      {
        IBP_autorun();
     EKG_autorun();
      }
     if(all_data_autorun_count%2==0)
      {
      co2_autorun(); // for etco2 AutoRun 
        
      }
     if(all_data_autorun_count%3==0)
      {
      
        
       
     sho_autodata_count++;
         EKG_auto_data(24+(all_data_autorun_count%3)-1,80+(all_data_autorun_count%3));        
        
      spo2_autorun(); // for spo2 AutoRun  
      }
     if(sho_autodata_count>20)
      {
        sho_autodata_count=0;
        IBP_chang_NIBP++;
        IBP_auto_data((int )(215+(2*all_data_autorun_count%2)),
           (int )170+(1*all_data_autorun_count%2),
           (int )190+(1*all_data_autorun_count%7),(int )82);        
      }
     if(IBP_chang_NIBP==5)
      {
        CleaAllAlarm();
        IBP_chang_NIBP=0;
        NIBP_auto_data(112,68,87,80);
        //Send_Internet_data_NIBP();//202107
        NIBP_show_time(2);
        mem_NIBP_write();
      }
    }
 }

void spo2_autorun(void)
{
  switch (order_spo2)
  {
    case 0:
      order_spo2 = 1;
      table_j = 0;
      PutMessage(Get_WhoUnpack(UART_1), header_spo2);
      PutMessage(Get_WhoUnpack(UART_1), spo2_table[table_i][table_j++]);
      PutMessage(Get_WhoUnpack(UART_1), header_puls);
      PutMessage(Get_WhoUnpack(UART_1), spo2_table[table_i][table_j++]);
      PutMessage(Get_WhoUnpack(UART_1), header_quty);
      PutMessage(Get_WhoUnpack(UART_1), spo2_table[table_i][table_j++]);
      PutMessage(Get_WhoUnpack(UART_1), header_info);
      PutMessage(Get_WhoUnpack(UART_1), spo2_table[table_i][table_j++]);
      if(spo2_table[table_i][0] == 96 || spo2_table[table_i][0] == 78)
      {
        if(Delay_++ == 180)
        {
          Delay_ = 0;
          table_i++;
        }
      }
      else	table_i++;
      
      if(table_i > 22) table_i = 0;
    break;
    case 1:
      order_spo2 = 2;
      PutMessage(Get_WhoUnpack(UART_1), header_wave);
      PutMessage(Get_WhoUnpack(UART_1), (spo2_curve[count_spo2++]-85)*2);
    case 2:
      PutMessage(Get_WhoUnpack(UART_1), (spo2_curve[count_spo2++]-85)*2);
      if(count_spo2>46) count_spo2=0, order_spo2=0;
    break;
  }
}
void EKG_autorun(void)
{

       //for(int i=0;i<496;i++)
 //    PutMessage(Get_WhoUnpack(UART_2), EKG_curve[count_EKG++]);
    EKG_auto_wave(EKG_curve[count_EKG++],EKG_RESP_curve[count_EKG_RESP++]/2);
    if(count_EKG>430) count_EKG=0;
    if(count_EKG_RESP>280) count_EKG_RESP=0;
    if(Get_DEMO_MOD_ONOFF()){
     if(Get_StateMachineStatus() == ST_MainScreen)
        {

            //if(!Get_OFF())
            EKG_draw_wave();
          EKG_draw_wave();
          EKG_draw_wave();
          EKG_draw_wave();
        }
    }
  //  PutMessage(MSG_DrawEKGWave,0);
  
}
void IBP_autorun(void)
{

      IBP_auto_wave(IBP_curve[count_IBP++]+2);
      IBP_auto_wave(IBP_curve[count_IBP++]+2);
     IBP_auto_wave(IBP_curve[count_IBP++]+2);
      //PutMessage(Get_WhoUnpack(UART_7), (IBP_curve[count_IBP++]-70)*2);
     // PutMessage(MSG_DrawIBPWave,0);

    if(count_IBP>=208) count_IBP=0;

  
}

void co2_autorun(void)
{
  change_etco2_value(co2_table[co2_i]);
  change_resp_value(resp_table[co2_i]);
  if(co2_table[co2_i] == 380)
  {
    if(Delay2++ == 90)
    {
      Delay2 = 0;
      co2_i++;
    }
  }
  else
  {
    if(Delay2++ == 30)
    {
      Delay2 = 0;
      co2_i++;
    }
  }
	
  if(co2_i>18) co2_i=0;

  PutMessage(Get_WhoUnpack(UART_3), (int)(co2_curve[count_co2++]));
  if(count_co2>448) count_co2=0;
}
